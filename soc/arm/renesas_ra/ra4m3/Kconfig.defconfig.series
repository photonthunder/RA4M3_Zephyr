## soc/arm/renesas_ra/ra4m3/Kconfig.defconfig.series
```kconfig
# Renesas RA4M3 MCU series configuration options

# Copyright (c) 2020 MXT Creation
# SPDX-License-Identifier: Apache-2.0

if SOC_SERIES_RA4M3

config SOC
	default "ra4m3"

config SOC_SERIES
	default "ra4m3"

rsource "Kconfig.defconfig.ra4m3*"

config SYS_CLOCK_HW_CYCLES_PER_SEC
	default 24000000

endif # SOC_SERIES_RA4M3
```

## soc/arm/renesas_ra/ra4m3/Kconfig.series
```kconfig
# Renesas RA4M3 MCU series

config SOC_SERIES_RA4M3
	bool "Renesas RA4M3 MCU"
	select ARM
	select CPU_CORTEX_M33
	select SOC_FAMILY_RA
	select CPU_HAS_ARM_MPU
	select CPU_CORTEX_M_HAS_DWT
	select HAS_RA_ROM_REG
	select FSP
	select CPU_HAS_FPU
	select FPU
	select FLOAT
	help
	  Enable support for Renesas RA4M3 Cortex-M33 microcontrollers.

#config SOC_SERIES_RA4M3
#	bool "Renesas RA4M3 MCU"
#	select ARM
#	select CPU_CORTEX_M33
#	select SOC_FAMILY_RA
#   select ARM_TRUSTZONE_M
#	select CPU_HAS_ARM_MPU
#	select CPU_HAS_FPU
#	select ARMV8_M_DSP
#	select CPU_CORTEX_M_HAS_DWT
#	help
#	  Enable support for Renesas RA4M3 Cortex-M33 microcontrollers.
```

## soc/arm/renesas_ra/ra4m3/Kconfig.soc
```kconfig
# SPDX-License-Identifier: Apache-2.0

choice
prompt "RA4M3 MCU Selection"
depends on SOC_SERIES_RA4M3

config SOC_PART_NUMBER_RA4M3AF3CFB
	bool "RA4M3AF3CFB"

config SOC_PART_NUMBER_RA4M3AF3CFP
	bool "RA4M3AF3CFP"

endchoice
```
