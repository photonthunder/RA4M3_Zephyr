## boards/arm/ek_ra4m3/Kconfig.board
```kconfig
# Renesas EK-RA4M3 board configuration

config BOARD_EK_RA4M3
	bool "Renesas RA4M3 Board"
	depends on SOC_PART_NUMBER_RA4M3AF3CFB
```

## boards/arm/ek_ra4m3/Kconfig.defconfig
```kconfig
# EK-RA4M3 Board configuration

config BOARD
	default "EK_RA4M3"
	depends on BOARD_EK_RA4M3
```

## boards/arm/ek_ra4m3/ek_ra4m3_defconfig
```kconfig
# SPDX-License-Identifier: Apache-2.0

CONFIG_SOC_SERIES_RA4M3=y
CONFIG_SOC_PART_NUMBER_RA4M3AF3CFB=y
CONFIG_BOARD_EK_RA4M3=y
CONFIG_USE_SEGGER_RTT=y
CONFIG_RTT_CONSOLE=y
# CONFIG_UART_RTT_DRIVER=y
CONFIG_CONSOLE=y
CONFIG_SEGGER_RTT_BUFFER_SIZE_UP=64
# CONFIG_UART_CONSOLE=y
CONFIG_SERIAL=y
CONFIG_UART_RA=y
# CONFIG_SCI_RA=y
# CONFIG_UART_USE_RUNTIME_CONFIGURE=n
# CONFIG_SCI_UART_CFG_RX_ENABLE=y
# CONFIG_SCI_UART_CFG_TX_ENABLE=y
# CONFIG_WDT_DISABLE_AT_BOOT=y
CONFIG_BOOT_BANNER=y
CONFIG_DEBUG=y
CONFIG_BUILD_OUTPUT_HEX=y

# Enable HW stack protection
CONFIG_HW_STACK_PROTECTION=y
```

## drivers/Kconfig
```kconfig
# SPDX-License-Identifier: Apache-2.0

rsource "gpio/Kconfig.ra"
rsource "serial/Kconfig.ra"
```

## drivers/gpio/Kconfig.ra
```kconfig
# RA GPIO configuration options

# SPDX-License-Identifier: Apache-2.0

config GPIO_RA
	bool "RA GPIO driver"
	default y
	depends on SOC_FAMILY_RA
	help
	  Enable the RA GPIO driver.
```

## drivers/serial/Kconfig.ra
```kconfig
# Renesas RA UART configuration options

config UART_RA
	bool "Renesas RA MCU family UART driver"
	default y
	depends on SOC_FAMILY_RA
	select SERIAL_HAS_DRIVER
	select SERIAL_SUPPORT_INTERRUPT
	help
	  This option enables the UARTx driver for Renesas RA MCUs.
```

## dts/bindings/arm/renesas,ra-sci.yaml
```yaml
description: RA family SCI (UART, SPI, I2C)

compatible: "renesas,ra-sci"

include: base.yaml

properties:
    reg:
      required: true

    interrupts:
      required: true

    instance-idx:
      type: int
      description: peripheral instance number
      required: true
```

## dts/bindings/gpio/renesas,ra-gpio.yaml
```yaml
description: RA GPIO PORT node

compatible: "renesas,ra-gpio"

include: [gpio-controller.yaml, base.yaml]

properties:
    reg:
      required: true

    interrupts:
      required: false

    label:
      required: true

    port:
      type: int
      required: true
      description: |
        The GPIO port number. GPIO port port0 has:

          port = <0>;

        And port1 has:

          port = <1>;

    "#gpio-cells":
      const: 2

    "#renesas,pin-cells":
      type: int
      required: true
      const: 2
      description: Number of items to expect in a renesas,pins specifier


gpio-cells:
  - pin
  - flags

renesas,pin-cells:
  - pin
  - config
```

## dts/bindings/pinctrl/renesas,ra-pinctrl.yaml
```yaml
# SPDX-License-Identifier: Apache-2.0

description:
  Reneasas RA Pinctrl container node

  The pincfg properties define devicetree flags that are converted to SoC flags at
  RENESAS_RA_PIN_FLAGS().

compatible: "renesas,ra-pinctrl"

include:
    - name: base.yaml
    - name: pincfg-node.yaml
      child-binding:
        property-allowlist:
          - bias-pull-up
          - input-enable
          - output-enable

properties:
    reg:
      required: true

properties:
    "#address-cells":
      required: true
      const: 1
    "#size-cells":
      required: true
      const: 1

child-binding:
    description: renesas pins
    properties:
      "renesas,pins":
        type: phandle-array

      pinmux-enable:
        required: false
        type: boolean
        description: |
          Assign pin to an embedded device peripheral
```

## dts/bindings/pinctrl/renesas,ra-pinmux.yaml
```yaml
description: Renesas RA PINMUX

compatible: "renesas,ra-pinmux"

include: base.yaml

properties:
    reg:
      required: true

pinmux-cells:
  - pin
  - function
```

## dts/bindings/serial/renesas,ra-uart.yaml
```yaml
description: Renesas RA UART Driver

compatible: "renesas,ra-uart"

include: uart-controller.yaml

properties:
    reg:
      required: true

    interrupts:
      required: true
      description: RXI (Receive Data Full), TXI (Transmit Data Empty), TEI (Transmit End), ERI (Receive Error)

    clocks:
      required: false

    clock-names:
      required: false

    rxpo:
      type: int
      required: false
      description: Receive Data Pinout

    txpo:
      type: int
      required: false
      description: Transmit Data Pinout

    instance-idx:
      type: int
      description: peripheral instance number
      required: true

    pinctrl-0:
      type: phandles
      description: |
        PIO pin configuration for SCI RXD & TXD signals.  We expect that
        the phandles will reference pinctrl nodes.  These nodes will
        have a nodelabel that matches the Renesas SoC HAL defines and
        be of the form p<port><pin><periph>.

        For example the UART on RA would be
           pinctrl-0 = <&p206_uart_urxd &p205_uart_utxd>;
      required: true
```

## misc/ek_ra4w1_ek_ra6m3/zephyr/boards/arm/ek_ra4w1/Kconfig.board
```kconfig
# Renesas EK-RA4W1 board configuration

# Copyright (c) 2020 MXT Creation
# SPDX-License-Identifier: Apache-2.0

config BOARD_EK_RA4W1
	bool "Renesas RA4W1 Board"
	depends on SOC_PART_NUMBER_RA4W1

config SCI_RA
	bool "Renesas RA serial comunication interface"
	
config SCI_UART_CFG_RX_ENABLE
	bool "Enable sci uart reception"
	
config SCI_UART_CFG_TX_ENABLE
	bool "Enable sci uart transmition"
```

## misc/ek_ra4w1_ek_ra6m3/zephyr/boards/arm/ek_ra4w1/Kconfig.defconfig
```kconfig
# EK-RA4W1 Board configuration

# Copyright (c) 2020 MXT Creation
# SPDX-License-Identifier: Apache-2.0

if BOARD_EK_RA4W1

config BOARD
	default "ek-ra4w1"

config GPIO
	default y

endif # BOARD_EK_RA4W1
```

## misc/ek_ra4w1_ek_ra6m3/zephyr/boards/arm/ek_ra4w1/ek_ra4w1_defconfig
```kconfig
# SPDX-License-Identifier: Apache-2.0

CONFIG_SOC_SERIES_RA=y
CONFIG_SOC_PART_NUMBER_RA4W1=y
CONFIG_BOARD_EK_RA4W1=y
CONFIG_CORTEX_M_SYSTICK=y
CONFIG_ARM_MPU=y
CONFIG_USE_SEGGER_RTT=y
CONFIG_RTT_CONSOLE=y
#CONFIG_UART_RTT_DRIVER=y
CONFIG_CONSOLE=y
CONFIG_SEGGER_RTT_BUFFER_SIZE_UP=64
#CONFIG_UART_CONSOLE=y
CONFIG_SERIAL=y
CONFIG_UART_RA=y
CONFIG_SCI_RA=y
CONFIG_SCI_UART_CFG_RX_ENABLE=y
CONFIG_SCI_UART_CFG_TX_ENABLE=y
CONFIG_WDT_DISABLE_AT_BOOT=y
CONFIG_BOOT_BANNER=y
CONFIG_DEBUG=y
CONFIG_BUILD_OUTPUT_HEX=y

# Enable HW stack protection
CONFIG_HW_STACK_PROTECTION=y
```

## misc/ek_ra4w1_ek_ra6m3/zephyr/boards/arm/ek_ra6m3/Kconfig.defconfig
```kconfig
# EK-RA6M2 Board configuration

# Copyright (c) 2020 MXT Creation
# SPDX-License-Identifier: Apache-2.0

if BOARD_EK_RA6M2

config BOARD
	default "ek-ra6m3"

config GPIO
	default y

endif # BOARD_EK_RA6M2
```

## misc/ek_ra4w1_ek_ra6m3/zephyr/drivers/serial/Kconfig.uart_ra
```kconfig
# Renesas RA UART configuration options

# Copyright (c) 2020 MXT Creation

config UART_RA
	bool "Renesas RA MCU family UART driver"
	depends on SOC_FAMILY_RA
	select SERIAL_HAS_DRIVER
	select SERIAL_SUPPORT_INTERRUPT
	help
	  This option enables the UARTx driver for Renesas RA MCUs.
```

## misc/ek_ra4w1_ek_ra6m3/zephyr/soc/arm/renesas_ra/Kconfig
```kconfig
# Renesas RA MCU family configuration options

# Copyright (c) 2020 MXT Creation
# SPDX-License-Identifier: Apache-2.0

config SOC_FAMILY_RA
	bool
	select HAS_SEGGER_RTT

if SOC_FAMILY_RA

config SOC_FAMILY
	string
	default "renesas_ra"
	
config SOC_SERIES
	string
	default "ra"

config GPIO_RA
	bool
	default y
	
config HAS_RA_ROM_REG
	bool

# Select SoC Part No. and configuration options
source "soc/arm/renesas_ra/ra/*/Kconfig.soc"

endif # SOC_FAMILY_RA
```

## misc/ek_ra4w1_ek_ra6m3/zephyr/soc/arm/renesas_ra/Kconfig.defconfig
```kconfig
# Renesas RA MCU family default configuration options

# Copyright (c) 2020 MXT Creation
# SPDX-License-Identifier: Apache-2.0

source "soc/arm/renesas_ra/ra/*/Kconfig.defconfig.series"

config WATCHDOG
	default y
	depends on SOC_FAMILY_RA

config RENESAS_DRIVER_AGT
	bool "Enable Renesas AGT driver"
	
config RENESAS_DRIVER_FLASH_LP
	bool "Enable Renesas FLASH LP driver"

config RENESAS_DRIVER_GPT
	bool "Enable Renesas GPT driver"

config RENESAS_DRIVER_ICU
	bool "Enable Renesas ICU driver"

config RENESAS_DRIVER_IOPORT
	bool "Enable Renesas IOPORT driver"
	
config RENESAS_BSP_DELAY
	bool "Enable Renesas BSP delay support"

config RENESAS_BSP_IRQ
	bool "Enable Renesas BSP irq support"

config RENESAS_BSP_REG_PROT
	bool "Enable Renesas BSP register protection support"

config RENESAS_BSP_CLOCKS
	bool "Enable Renesas BSP clocks support"

config RENESAS_BSP_COMMON
	bool "Enable Renesas BSP common support"
	
config RENESAS_BSP_API
	bool "Enable Renesas BSP api support"
```

## misc/ek_ra4w1_ek_ra6m3/zephyr/soc/arm/renesas_ra/ra/ra4w1/Kconfig.defconfig.series
```kconfig
# Renesas RA4W1 MCU series configuration options

# Copyright (c) 2020 MXT Creation
# SPDX-License-Identifier: Apache-2.0

if SOC_PART_NUMBER_RA4W1

config SOC_SERIES
	default "ra"

config SOC
	default "ra4w1"

config SOC_PART_NUMBER
	default "r7fa4w1ad"

#
# RA family has total 47 peripherals capable of
# generating interrupts.
#
config NUM_IRQS
	default 47

config SYS_CLOCK_HW_CYCLES_PER_SEC
	default 32000000

config BLE_RA4W1
	bool "Enable Renesas BLE API"
	select RENESAS_DRIVER_AGT
	select RENESAS_DRIVER_FLASH_LP
	select RENESAS_DRIVER_GPT
	select RENESAS_DRIVER_ICU
	select RENESAS_DRIVER_IOPORT
	
config USE_RENESAS_BSP
	bool "renesas_bsp"
	default "y"
	select RENESAS_BSP_DELAY
	select RENESAS_BSP_IRQ
	select RENESAS_BSP_REG_PROT
	select RENESAS_BSP_CLOCKS
	select RENESAS_BSP_COMMON
	select RENESAS_BSP_API


endif # SOC_SERIES_RA
```

## misc/ek_ra4w1_ek_ra6m3/zephyr/soc/arm/renesas_ra/ra/ra6m3/Kconfig.defconfig.series
```kconfig
# Renesas RA6M3 MCU series configuration options

# Copyright (c) 2020 MXT Creation
# SPDX-License-Identifier: Apache-2.0

if SOC_PART_NUMBER_RA6M3

config SOC_SERIES
	default "ra"

config SOC
	default "ra6m3"

config SOC_PART_NUMBER
	default "r7fa6m3ah"

#
# RA family has total 47 peripherals capable of
# generating interrupts.
#
config NUM_IRQS
	default 111

config SYS_CLOCK_HW_CYCLES_PER_SEC
	default 120000000

endif # SOC_SERIES_RA
```

## soc/arm/renesas_ra/Kconfig
```kconfig
# Renesas RA MCU family configuration options

config SOC_FAMILY_RA
	bool
	select HAS_SEGGER_RTT
	select BUILD_OUTPUT_HEX

if SOC_FAMILY_RA

config SOC_FAMILY
	string
	default "renesas_ra"

rsource "*/Kconfig.soc"

endif # SOC_FAMILY_RA
```

## soc/arm/renesas_ra/common/Kconfig.defconfig.series
```kconfig
# SPDX-License-Identifier: Apache-2.0

if SOC_FAMILY_RA

config NUM_IRQS
	default 95

config GPIO_RA
	default GPIO

#config HWINFO_RA
#	default HWINFO

#config I2C_RA
#	default I2C

#config PINMUX_RA
#	default PINMUX


#config SPI_RA
#	default SPI

config UART_RA
	default SERIAL

#config WDT_RA
#	default WATCHDOG

endif # SOC_FAMILY_RA
```

## soc/arm/renesas_ra/common/Kconfig.soc
```kconfig
# SPDX-License-Identifier: Apache-2.0

# Copyright (c) 2019 ML!PA Consulting GmbH
# SPDX-License-Identifier: Apache-2.0

if SOC_FAMILY_RA

choice
	prompt "Main clock source"
	help
	  Selects the clock source

config SOC_RA_SUBCLK32K_AS_MAIN
	bool "SUBCLK32K"

config SOC_RA_PLL_AS_MAIN
	bool "PLL"

config SOC_RA_XOSC_20MHZ_AS_MAIN
	bool "XOSC20MHZ"

endchoice

endif
```

## soc/arm/renesas_ra/ra4m3/Kconfig.defconfig.ra4m3af3cfb
```kconfig
# Evaluation Kit EK-RA4M3 uses: R7FA4M3AF3CFB
# 144 pins

# SPDX-License-Identifier: Apache-2.0

if SOC_PART_NUMBER_RA4M3AF3CFB

config SOC_PART_NUMBER
    string
	default "ra4m3af3cfb"

endif
```

## soc/arm/renesas_ra/ra4m3/Kconfig.defconfig.ra4m3af3cfp
```kconfig
# Using: R7FA4M3AF3CFP - 100 pins

if SOC_PART_NUMBER_RA4M3AF3CFP

config SOC_PART_NUMBER
    string
	default "ra4m3af3cfp"

endif
```
